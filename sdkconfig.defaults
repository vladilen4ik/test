## sdkconfig.defaults
```kconfig
# ESP32 Matter Lock Bridge Configuration

# ESP32-specific
CONFIG_IDF_TARGET="esp32"

# Partition Table
CONFIG_PARTITION_TABLE_CUSTOM=y
CONFIG_PARTITION_TABLE_CUSTOM_FILENAME="partitions.csv"
CONFIG_PARTITION_TABLE_FILENAME="partitions.csv"

# Serial flasher config
CONFIG_ESPTOOLPY_FLASHSIZE_4MB=y

# Compiler options
CONFIG_COMPILER_OPTIMIZATION_SIZE=y
CONFIG_COMPILER_CXX_EXCEPTIONS=y
CONFIG_COMPILER_CXX_EXCEPTIONS_EMG_POOL_SIZE=0

# ESP32 specific config
CONFIG_ESP32_ENABLE_COREDUMP_TO_FLASH=n
CONFIG_ESP32_DEFAULT_CPU_FREQ_240=y

# Bluetooth controller
CONFIG_BT_ENABLED=y
CONFIG_BT_NIMBLE_ENABLED=y
CONFIG_BT_NIMBLE_PINNED_TO_CORE_0=y
CONFIG_BT_NIMBLE_PINNED_TO_CORE=0

# Matter specific configurations
CONFIG_ENABLE_CHIP_SHELL=y
CONFIG_CHIP_ENABLE_PAIRING_AUTOSTART=y
CONFIG_CHIP_LIB_SHELL=y
CONFIG_CHIP_ENABLE_WIFI=y
CONFIG_CHIP_WIFI_STATION_SSID_LIMIT=32
CONFIG_CHIP_WIFI_STATION_PASSWORD_LIMIT=64

# FreeRTOS
CONFIG_FREERTOS_UNICORE=n
CONFIG_FREERTOS_HZ=1000
CONFIG_FREERTOS_IDLE_TASK_STACKSIZE=3072

# Log output
CONFIG_LOG_DEFAULT_LEVEL_INFO=y
CONFIG_LOG_MAXIMUM_EQUALS_DEFAULT=y
CONFIG_BOOTLOADER_LOG_LEVEL_WARN=y

# LWIP
CONFIG_LWIP_IPV6=y
CONFIG_LWIP_IPV6_AUTOCONFIG=y
CONFIG_LWIP_IPV6_FORWARD=y
CONFIG_LWIP_NETIF_LOOPBACK=y
CONFIG_LWIP_LOOPBACK_MAX_PBUFS=8

# mbedTLS
CONFIG_MBEDTLS_KEY_EXCHANGE_ECJPAKE=y
CONFIG_MBEDTLS_ECJPAKE_C=y
CONFIG_MBEDTLS_ENABLE_HEAP=y
CONFIG_MBEDTLS_HEAP_SIZE=90000

# NVS
CONFIG_NVS_ENCRYPTION=y

# GPIO configuration
CONFIG_GPIO_ESP32_SUPPORT_SWITCH_SLP_PULL=y

# Main task
CONFIG_ESP_MAIN_TASK_STACK_SIZE=8192

# Memory management
CONFIG_ESP_SYSTEM_ALLOW_RTC_FAST_MEM_AS_HEAP=y

# WiFi
CONFIG_ESP32_WIFI_STATIC_RX_BUFFER_NUM=8
CONFIG_ESP32_WIFI_DYNAMIC_RX_BUFFER_NUM=16
CONFIG_ESP32_WIFI_STATIC_TX_BUFFER=y
CONFIG_ESP32_WIFI_STATIC_TX_BUFFER_NUM=8
CONFIG_ESP32_WIFI_CACHE_TX_BUFFER_NUM=16
CONFIG_ESP32_WIFI_ENABLE_WPA3_SAE=y

# CHIP/Matter configuration
CONFIG_USE_MINIMAL_MDNS=n
CONFIG_ENABLE_EXTENDED_DISCOVERY=y
CONFIG_CHIP_DEVICE_PRODUCT_NAME="Matter Lock Bridge"
CONFIG_CHIP_DEVICE_VENDOR_NAME="ESP32"
CONFIG_CHIP_DEVICE_PRODUCT_ID=0x0001
CONFIG_CHIP_DEVICE_VENDOR_ID=0x131B

# Enable console
CONFIG_ESP_CONSOLE_UART_DEFAULT=y

# Task watchdog
CONFIG_ESP_TASK_WDT=y
CONFIG_ESP_TASK_WDT_TIMEOUT_S=30

# System
CONFIG_ESP_SYSTEM_EVENT_TASK_STACK_SIZE=4096

# TCP
CONFIG_LWIP_TCP_SND_BUF_DEFAULT=65534
CONFIG_LWIP_TCP_WND_DEFAULT=65534
CONFIG_LWIP_TCP_RECVMBOX_SIZE=64

# UDP
CONFIG_LWIP_UDP_RECVMBOX_SIZE=64

# Security features
CONFIG_SECURE_BOOT=n
CONFIG_SECURE_FLASH_ENC_ENABLED=n

# App update
CONFIG_APP_RETRIEVE_LEN_ELF_SHA=16

# Timer
CONFIG_ESP_TIMER_TASK_STACK_SIZE=4096

# Event loop
CONFIG_ESP_EVENT_LOOP_PROFILING=n

# VFS
CONFIG_VFS_SUPPORT_IO=y
```
